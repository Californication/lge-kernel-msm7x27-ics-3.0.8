## arch/arm/mach-msm/lge/Kconfig
```kconfig
config MACH_LGE
	bool

menu "LGE Device-Specific Changes"

menu "LGE Board Selection"

config MACH_MSM7X27_SWIFT
  depends on ARCH_MSM7X27
  depends on !MSM_STACKED_MEMORY
  select MACH_LGE
  bool "MSM7x27 SWIFT"
  help
    Support for the Qualcomm MSM7x27 SWIFT LG GT540 (Optimus).

endmenu

config LGE_HEADSET
	bool

config LGE_HEADSET_ADC
	tristate "LGE GPIO 2 Wire detection driver using ADC"
	default n
	depends on MACH_LGE
	select LGE_HEADSET
	help
	  LGE GPIO 2 Wire detection driver

config LGE_HEADSET_2GPIO
	tristate "LGE GPIO 2 Wire detection driver using 2 GPIO"
	default n
	depends on MACH_LGE
	select LGE_HEADSET
	help
	  LGE GPIO 2 Wire detection driver by using 2 GPIO

config LGE_SWITCH_GPIO
	tristate "LGE GPIO switch driver"
	depends on MACH_LGE
	default n
	help
	  LGE GPIO switch driver 

config LGE_PROC_COMM
	bool "LGE added proc comm"
	depends on MACH_LGE
	default n
	help
	  LGE added proc_comm

config LGE_4G_DDR
	bool "Memory Configuration - 2G/4G DDR RAM "
	depends on MACH_LGE
	default n
	help
	  This patch is used to configure type of Memory
	  Aloha Global use Hynix 4G DDR RAM

config LGE_FBCON_INACTIVE_CONSOLE
	bool "Support LGE FBCON inactive console"
	default n
	depends on MACH_LGE
	help
	 Choose if inactive console

config LGE_UMS_PERFORMANCE_PATCH
	bool "Increasing UMS R/W performance patch"
	default n
	help
	  This patch is QCT's patch code for increasing UMS R/W Performance
	  It change maximum interrupt interval from 8 micro-frame to immediate

config LGE_YAFFS_AUTO_CHECKPOINT_PATCH
	bool "LGE yaffs auto checkpoint patch"
	default n
	help
	  set value of yaffs_auto_checkpoint to 2. this patch can decreases 
	  mount time due to scanning all blocks of yaffs partition

config LGE_BRCM_H4_LPM_SUPPORT_PATCH
	bool "LGE brcm's bluetooth lpm patch"
	default n
	help
	  Support brcm's bluetooth LPM requirement

config LGE_MMC_CLEANUP_PATCH
	bool "LGE mmc queue cleanup patch"
	default n
	help
	  This patch is added for prevent kernel panic in case of doing
	  insert/eject repeatedly. this patch are from 2.6.32 mainstream
	  kernel

endmenu
```

## drivers/input/sensor_swift/Kconfig
```kconfig
#
# Sensor driver configuration
#
menuconfig INPUT_SENSOR
	bool "Sensors"
	help
	  Say Y here, and a list of supported touchscreens will be displayed.
	  This option doesn't affect the kernel.

	  If unsure, say Y.

if INPUT_SENSOR

config SENSOR_BMA150_SWIFT
	tristate "BMA150 based accelerometer sensor"
	help
	  Say Y here if you have a sensor interface using the
	  BMA150 controller, and your board-specific
	  setup code includes i2c devices.

	  If unsure, say N (but it's safe to say "Y").

	  To compile this driver as a module, choose M here: the
	  module will be called ads7846.
	  
config SENSOR_AK8973_SWIFT
	tristate "AK8973 based ecompass sensor"
	help
	  Say Y here if you have a sensor interface using the
	  AK8973 controller, and your board-specific
	  setup code includes i2c devices.

	  If unsure, say N (but it's safe to say "Y").

	  To compile this driver as a module, choose M here: the
	  module will be called ads7846.

endif
```
